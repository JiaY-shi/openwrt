// SPDX-License-Identifier: GPL-2.0-only

&soc {
		nss-common {
			compatible = "qcom,nss-common";
			reg = <0x01868010 0x01>;
			reg-names = "nss-misc-reset";
		};

		nss0: nss@40000000 {
			compatible = "qcom,nss";
			interrupts = <0 402 0x1>, <0 401 0x1>, <0 400 0x1>,
				     <0 399 0x1>, <0 398 0x1>, <0 397 0x1>,
				     <0 396 0x1>, <0 395 0x1>;
			reg = <0x07a00000 0x100>, <0x0b111000 0x1000>;
			reg-names = "nphys", "qgic-phys";
			clocks = <&gcc GCC_UBI0_CFG_CLK>,
				 <&gcc GCC_UBI0_DBG_CLK>,
				 <&gcc GCC_UBI0_CORE_CLK>,
				 <&gcc GCC_UBI0_UTCM_CLK>,
				 <&gcc GCC_UBI0_AXI_CLK>,
				 <&gcc GCC_SNOC_UBI0_AXI_CLK>,
				 <&gcc GCC_UBI0_NC_AXI_CLK>;
			clock-names = "nss-cfg-clk", "nss-dbg-clk",
				      "nss-core-clk", "nss-utcm-clk",
				      "nss-axi-clk",
				      "nss-snoc-axi-clk",
				      "nss-nc-axi-clk";
			qcom,id = <0>;
			qcom,num-queue = <4>;
			qcom,num-irq = <8>;
			qcom,num-pri = <4>;
			qcom,load-addr = <0x40000000>;
			qcom,low-frequency = <850000000>;
			qcom,mid-frequency = <850000000>;
			qcom,max-frequency = <1000000000>;
			qcom,ipv4-enabled;
			qcom,ipv4-reasm-enabled;
			qcom,ipv6-enabled;
			qcom,ipv6-reasm-enabled;
			qcom,tun6rd-enabled;
			qcom,l2tpv2-enabled;
			qcom,gre-enabled;
			qcom,map-t-enabled;
			qcom,pppoe-enabled;
			qcom,pptp-enabled;
			qcom,tunipip6-enabled;
			qcom,shaping-enabled;
			qcom,clmap-enabled;
			qcom,vxlan-enabled;
			qcom,match-enabled;
			qcom,mirror-enabled;
			qcom,crypto-enabled;
			qcom,ipsec-enabled;
			qcom,wlanredirect-enabled;
			qcom,gre-redir-enabled;
			qcom,gre-redir-mark-enabled;
			qcom,portid-enabled;
			qcom,wlan-dataplane-offload-enabled;
			qcom,pvxlan-enabled;
			qcom,udp-st-enabled;
		};
};